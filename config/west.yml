## config/west.yml
```yaml
manifest:
  remotes:
    - name: zmkfirmware
      url-base: https://github.com/zmkfirmware
    - name: sadekbaroudi
      url-base: https://github.com/sadekbaroudi
  projects:
    - name: zmk
      remote: zmkfirmware
      # Pinned to a validated ZMK main commit (2026-07-04) until ZMK tags v0.4.
      revision: 484a0547078228f6957ed164523823e39fbedec4
      import: app/west.yml
    - name: zmk-fingerpunch-keyboards
      remote: sadekbaroudi
      revision: main
      import: config/deps.yml
  self:
    path: config
```
