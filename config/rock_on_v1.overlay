// Add this file to override any keyboard specific devicetree configuration
// INPUT_TRANSFORM_* macros:
#include <dt-bindings/zmk/input_transform.h>
// &zip_xy_transform (and the other input processor nodes):
#include <input/processors.dtsi>

// In this case, we added a cirque trackpad using the pro micro position i2c pins and a hand wired data ready pin
&pro_micro_i2c {
    status = "okay";
    
    glidepoint: glidepoint@2a {
        compatible = "cirque,pinnacle";
        reg = <0x2a>;
        status = "okay";
        // The aforementioned LED data pin that we're not using, hand wired to cirque DR
        data-ready-gpios = <&gpio0 6 (GPIO_ACTIVE_HIGH)>;

        sensitivity = "4x";
        sleep-mode-enable;
        // ZMK v0.4: `no-taps` was removed. Taps are off by default; add
        // `primary-tap-enable;` here if you want tap-to-click.
    };
};

/ {
    glidepoint_listener {
        compatible = "zmk,input-listener";
        device = <&glidepoint>;
        // input-processors = <&zip_xy_transform (INPUT_TRANSFORM_XY_SWAP | INPUT_TRANSFORM_X_INVERT | INPUT_TRANSFORM_Y_INVERT)>;
    };
};

